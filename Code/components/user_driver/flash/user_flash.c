/*
 * user_flash.c
 *
 *  Created on: Jan 9, 2021
 *      Author: ductu
 */
/***********************************************************************************************************************
* Pragma directive
***********************************************************************************************************************/

/***********************************************************************************************************************
* Includes <System Includes>
***********************************************************************************************************************/
#include "user_flash.h"
#include "esp_spiffs.h"
#include <dirent.h>
#include "nvs_flash.h"
/***********************************************************************************************************************
* Macro definitions
***********************************************************************************************************************/

/***********************************************************************************************************************
* Typedef definitions
***********************************************************************************************************************/

/***********************************************************************************************************************
* Private global variables and functions
***********************************************************************************************************************/
esp_vfs_spiffs_conf_t conf = {
    .base_path = "/spiffs",
    .partition_label = NULL,
    .max_files = 5,
    .format_if_mount_failed = true};

/***********************************************************************************************************************
* Exported global variables and functions (to be accessed by other files)
***********************************************************************************************************************/

/***********************************************************************************************************************
* Imported global variables and functions (from other files)
***********************************************************************************************************************/
/***********************************************************************************************************************
* Function Name: flash_erase_all_partions
* Description  : format all 
* Arguments    : none
* Return Value : none
***********************************************************************************************************************/
void flash_erase_all_partions(void)
{
    APP_LOGI("erase all nvs partions");
    nvs_flash_erase();
    APP_LOGI("erase all spiffs partions");
    esp_spiffs_format(conf.partition_label);
    esp_vfs_spiffs_unregister(&conf);
}
/***********************************************************************************************************************
* Function Name: 
* Description  :
* Arguments    : none
* Return Value : none
***********************************************************************************************************************/
void flash_file_init(void)
{
    esp_err_t ret = esp_vfs_spiffs_register(&conf);

    if (ret != ESP_OK)
    {
        if (ret == ESP_FAIL)
        {
            APP_LOGE("Failed to mount or format filesystem");
        }
        else if (ret == ESP_ERR_NOT_FOUND)
        {
            APP_LOGE("Failed to find SPIFFS partition");
        }
        else
        {
            APP_LOGE("Failed to initialize SPIFFS (%d)", ret);
        }
    }
}
/***********************************************************************************************************************
* Function Name: logger_list_file
* Description  : 
* Arguments    : file_name name of file need check
                 dir dir of file name
* Return Value : true/false
***********************************************************************************************************************/
bool logger_list_file(char *location)
{
    DIR *d;
    struct dirent *dir;
    bool status = true;
    d = opendir(location);
    if (d)
    {
        while ((dir = readdir(d)) != NULL)
        {
            APP_LOGD("**** %s\n", dir->d_name);
        }
        closedir(d);
    }
    return status;
}

/***********************************************************************************************************************
* Function Name: check_map_size
* Description  : 
* Arguments    : 
* Return Value : true/false
***********************************************************************************************************************/

uint8_t check_map_size(void)
{
    bool status = false;
    size_t total = 0, used = 0;
    esp_err_t ret = esp_spiffs_info(conf.partition_label, &total, &used);
    if (ret != ESP_OK)
    {
        status = false;
        APP_LOGD("Failed to get SPIFFS partition information (%s)", esp_err_to_name(ret));
    }
    else
    {
        status = true;
        APP_LOGD("Partition size: total: %d Mb, used: %d", total, used);
    }
    return status;
}

/***********************************************************************************************************************
* Static Functions
***********************************************************************************************************************/

/***********************************************************************************************************************
* End of file
***********************************************************************************************************************/
